#include "dactyl.dtsi"

&kscan0 {
    col-gpios
        = <&gpio1 4  GPIO_ACTIVE_HIGH> // column 0
        , <&gpio0 11 GPIO_ACTIVE_HIGH> // Column 1
        , <&gpio1 0  GPIO_ACTIVE_HIGH> // Column 2
        , <&gpio0 24 GPIO_ACTIVE_HIGH> // Column 3
        , <&gpio0 22 GPIO_ACTIVE_HIGH> // Column 4
        , <&gpio0 20 GPIO_ACTIVE_HIGH> // Column 5
    ;
};